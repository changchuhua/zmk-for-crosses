## config/boards/shields/crosses/Kconfig.defconfig
```kconfig
if SHIELD_CROSSES_RIGHT

config ZMK_KEYBOARD_NAME
	default "Crosses"

config ZMK_SPLIT_BLE_ROLE_CENTRAL
	default y

endif

if SHIELD_CROSSES_LEFT || SHIELD_CROSSES_RIGHT

if SHIELD_CROSSES_LEFT

config ZMK_KEYBOARD_NAME
    default "Crosses Left"

endif

if SHIELD_CROSSES_RIGHT

config ZMK_KEYBOARD_NAME
    default "Crosses Right"

endif

config ZMK_SPLIT
	default y

endif
```

## config/west.yml
```yaml
manifest:
  remotes:
    - name: zmkfirmware
      url-base: https://github.com/zmkfirmware
    - name: DoctorWangWang
      url-base: https://github.com/DoctorWangWang
    - name: badjeff
      url-base: https://github.com/badjeff
    - name: efogdev
      url-base: https://github.com/efogdev
      
  projects:
    - name: zmk
      remote: zmkfirmware
      revision: main
      import: app/west.yml
    - name: zmk-pmw3610-driver
      remote: efogdev
      revision: main
      
  self:
    path: config
```
